## conf/bblayers.conf.sample
```bitbake
BBPATH ?= "${TOPDIR}"
BBFILES ?= ""

BBLAYERS ?= " \
    ##OEROOT##/meta \
    ##OEROOT##/../meta-openembedded/meta-oe \
    ##OEROOT##/../meta-openembedded/meta-python \
    ##OEROOT##/../meta-openembedded/meta-networking \
    ##OEROOT##/../meta-picocom \
    ##OEROOT##/../meta-riscv \
    "
```

## conf/distro/picocom-palladium.conf
```bitbake
DISTRO_FEATURES:append = " multiarch systemd "

PACKAGE_CLASSES ?= "package_deb package_rpm"

DISTRO_FEATURES_BACKFILL_CONSIDERED = "sysvinit"

VIRTUAL-RUNTIME_init_manager = "systemd"
VIRTUAL-RUNTIME_initscripts = "systemd-compat-units"
```

## conf/distro/picocom.conf
```bitbake
DISTRO_FEATURES:append = " multiarch systemd"
DISTRO_FEATURES_BACKFILL_CONSIDERED += "systemd"

VIRTUAL-RUNTIME_init_manager = "systemd"
```

## conf/layer.conf
```bitbake
# We have a conf and classes directory, add to BBPATH
BBPATH =. "${LAYERDIR}:"

# We have recipes-* directories, add to BBFILES
BBFILES += "${LAYERDIR}/recipes-*/*/*.bb \
            ${LAYERDIR}/recipes-*/*/*.bbappend"

BBFILE_COLLECTIONS += "meta-picocom"
BBFILE_PATTERN_meta-picocom = "^${LAYERDIR}/"
BBFILE_PRIORITY_meta-picocom = "6"

LAYERSERIES_COMPAT_meta-picocom = "kirkstone"

LAYERDEPENDS_meta-picocom = "core"

# This should only be incremented on significant changes that will
# cause compatibility issues with other layers
LAYERVERSION_yocto = "3"

REQUIRED_POKY_BBLAYERS_CONF_VERSION = "2"
```

## conf/machine/include/picocom-linux.inc
```bitbake
KERNEL_CLASSES = "kernel-fitimage"
KERNEL_IMAGETYPE = "Image"

PREFERRED_PROVIDER_virtual/kernel ?= "linux-picocom"
PREFERRED_PROVIDER_virtual/bootloader ?= "u-boot-picocom"

SERIAL_CONSOLES = "115200;ttyS0"

IMAGE_FSTYPES ?= "wic.gz wic.bmap ext4"

# U-Boot ITB (FIT image with U-Boot S-mode, OpenSBI FW_DYNAMIC, DTB [from
# U-Boot source code tree])
UBOOT_SUFFIX ?= "itb"

UBOOT_ENTRYPOINT = "0x600000"
UBOOT_DTB_LOADADDRESS = "0x20000000"

## wic default support
WKS_FILE_DEPENDS ?= " \
    u-boot-picocom \
    opensbi-picocom \
    e2fsprogs-native \
    bmap-tools-native \
"

IMAGE_BOOT_FILES ?= " \
    ${KERNEL_IMAGETYPE} \
    ${RISCV_SBI_FDT} \
    boot.scr.uimg \
    uEnv.txt \
    u-boot.itb \
    u-boot-spl.bin \
"

##TODO
WKS_FILE ?= "ae350-ax45mp-spl.wks"
```

## conf/machine/pc803-qemu.conf
```bitbake
require conf/machine/include/riscv/tune-riscv.inc

KERNEL_IMAGETYPE = "Image"

KERNEL_DEVICETREE ?= ""
KBUILD_DEFCONFIG ?= "defconfig"

PREFERRED_PROVIDER_virtual/kernel ?= "linux-thead"
```

## conf/machine/pc805.conf
```bitbake
#@TYPE: Machine
#@NAME: pc805
#@SOC: Pico PC805
#@DESCRIPTION: Machine configuration for the Picocom PC805
#@MAINTAINER: Gavin Gao <attinagaoxu@gmail.com>

DEFAULTTUNE ?= "riscv32"
require conf/machine/include/riscv/tune-riscv.inc

MACHINE_FEATURES = "screen keyboard ext2 ext3 serial"

KERNEL_CLASSES = "kernel-fitimage"
KERNEL_IMAGETYPE = "fitImage"
KERNEL_DEVICETREE ?= "picocom/pc805.dtb"

PREFERRED_PROVIDER_virtual/kernel ?= "linux-picocom"
PREFERRED_PROVIDER_virtual/bootloader ?= "u-boot-picocom"

PREFERRED_VERSION_u-boot-picocom = "2020.10"

EXTRA_IMAGEDEPENDS += "opensbi-picocom"
RISCV_SBI_PLAT = "picocom/pc805"
RISCV_SBI_FDT ?= "pc805.dtb"

SERIAL_CONSOLES = "115200;ttyS0"

MACHINE_EXTRA_RRECOMMENDS += " kernel-modules"

IMAGE_FSTYPES ?= "wic.gz wic.bmap ext4"


EXTRA_IMAGEDEPENDS += "u-boot-picocom"
UBOOT_MACHINE = "picocom_pc805_rv32_spl_defconfig"

# U-Boot SPL
SPL_BINARY ?= "spl/u-boot-spl.bin"

# U-Boot ITB (FIT image with U-Boot S-mode, OpenSBI FW_DYNAMIC, DTB [from
# U-Boot source code tree])
UBOOT_SUFFIX ?= "itb"

UBOOT_ENTRYPOINT = "0x80400000"
UBOOT_DTB_LOADADDRESS = "0x82200000"

## wic default support
WKS_FILE_DEPENDS ?= " \
    u-boot-picocom \
    opensbi-picocom \
    e2fsprogs-native \
    bmap-tools-native \
"

IMAGE_BOOT_FILES ?= " \
    ${KERNEL_IMAGETYPE} \
    ${RISCV_SBI_FDT} \
    u-boot.bin \
    u-boot-spl.bin \
"

WKS_FILE ?= "pc805-spl.wks"
```

## recipes-kernel/linux/linux-picocom/pc805_defconfig
```kconfig
CONFIG_DEFAULT_HOSTNAME="pc805"
CONFIG_SYSVIPC=y
CONFIG_NO_HZ_IDLE=y
CONFIG_IKCONFIG=y
CONFIG_CGROUPS=y
CONFIG_NAMESPACES=y
CONFIG_BLK_DEV_INITRD=y
# CONFIG_RD_GZIP is not set
# CONFIG_RD_BZIP2 is not set
# CONFIG_RD_LZMA is not set
# CONFIG_RD_XZ is not set
# CONFIG_RD_LZO is not set
# CONFIG_RD_LZ4 is not set
CONFIG_EMBEDDED=y
# CONFIG_VM_EVENT_COUNTERS is not set
CONFIG_SLAB=y
CONFIG_PICOCOM_PC805=y
# CONFIG_PLATFORM_AHBDMA is not set
CONFIG_ARCH_RV32I=y
# CONFIG_DSP is not set
CONFIG_HZ_1000=y
CONFIG_CMDLINE="console=hvc0 earlycon=sbi"
# CONFIG_SUSPEND is not set
CONFIG_ARCH_MMAP_RND_BITS=17
CONFIG_MODULES=y
CONFIG_MODULE_UNLOAD=y
# CONFIG_BLK_DEV_BSG is not set
# CONFIG_MQ_IOSCHED_DEADLINE is not set
# CONFIG_MQ_IOSCHED_KYBER is not set
CONFIG_FRONTSWAP=y
CONFIG_CMA=y
CONFIG_CMA_DEBUG=y
CONFIG_NET=y
CONFIG_PACKET=y
CONFIG_PACKET_DIAG=y
CONFIG_UNIX=y
CONFIG_UNIX_DIAG=y
CONFIG_XFRM_STATISTICS=y
CONFIG_NET_KEY=y
CONFIG_NET_KEY_MIGRATE=y
CONFIG_INET=y
CONFIG_IP_MULTICAST=y
CONFIG_IP_ADVANCED_ROUTER=y
CONFIG_IP_FIB_TRIE_STATS=y
CONFIG_IP_MULTIPLE_TABLES=y
CONFIG_IP_ROUTE_MULTIPATH=y
CONFIG_IP_ROUTE_VERBOSE=y
CONFIG_IP_PNP=y
CONFIG_IP_PNP_DHCP=y
CONFIG_IP_PNP_BOOTP=y
CONFIG_IP_PNP_RARP=y
CONFIG_IP_MROUTE=y
CONFIG_IP_MROUTE_MULTIPLE_TABLES=y
CONFIG_IP_PIMSM_V1=y
CONFIG_IP_PIMSM_V2=y
CONFIG_SYN_COOKIES=y
CONFIG_INET_IPCOMP=y
CONFIG_INET_UDP_DIAG=y
CONFIG_INET_RAW_DIAG=y
CONFIG_INET_DIAG_DESTROY=y
CONFIG_TCP_CONG_ADVANCED=y
CONFIG_TCP_CONG_BIC=y
CONFIG_TCP_CONG_WESTWOOD=y
CONFIG_TCP_CONG_HTCP=y
CONFIG_TCP_MD5SIG=y
# CONFIG_IPV6 is not set
CONFIG_NETFILTER=y
CONFIG_BRIDGE_NETFILTER=y
CONFIG_NF_SOCKET_IPV4=y
CONFIG_NF_TPROXY_IPV4=y
CONFIG_NF_DUP_IPV4=y
CONFIG_NF_LOG_ARP=y
CONFIG_NF_LOG_IPV4=y
CONFIG_NF_REJECT_IPV4=y
CONFIG_IP_DCCP=y
CONFIG_IP_SCTP=y
CONFIG_L2TP=y
CONFIG_BRIDGE=y
# CONFIG_BRIDGE_IGMP_SNOOPING is not set
CONFIG_NET_DSA=y
CONFIG_NET_SCHED=y
CONFIG_NETLINK_DIAG=y
CONFIG_MPLS=y
CONFIG_NET_NSH=y
CONFIG_DEVTMPFS=y
CONFIG_DEVTMPFS_MOUNT=y
# CONFIG_BLK_DEV is not set
CONFIG_NETDEVICES=y
CONFIG_STMMAC_ETH=y
CONFIG_DWMAC_DWC_QOS_ETH=y
# CONFIG_DWMAC_GENERIC is not set
# CONFIG_INPUT_KEYBOARD is not set
# CONFIG_INPUT_MOUSE is not set
# CONFIG_SERIO is not set
CONFIG_VT_HW_CONSOLE_BINDING=y
# CONFIG_LEGACY_PTYS is not set
# CONFIG_LDISC_AUTOLOAD is not set
CONFIG_SERIAL_8250=y
# CONFIG_SERIAL_8250_DEPRECATED_OPTIONS is not set
CONFIG_SERIAL_8250_CONSOLE=y
CONFIG_SERIAL_8250_NR_UARTS=3
CONFIG_SERIAL_8250_RUNTIME_UARTS=3
CONFIG_SERIAL_8250_DW=y
CONFIG_SERIAL_OF_PLATFORM=y
CONFIG_SERIAL_EARLYCON_RISCV_SBI=y
CONFIG_HVC_RISCV_SBI=y
# CONFIG_HW_RANDOM is not set
CONFIG_I2C=y
CONFIG_I2C_CHARDEV=y
CONFIG_I2C_DESIGNWARE_PLATFORM=y
CONFIG_SPI=y
CONFIG_SPI_DESIGNWARE=y
CONFIG_SPI_DW_MMIO=y
CONFIG_SPI_DW_DMA=y
CONFIG_SPI_SPIDEV=y
# CONFIG_HWMON is not set
# CONFIG_HID is not set
# CONFIG_USB_SUPPORT is not set
CONFIG_SYNC_FILE=y
# CONFIG_VIRTIO_MENU is not set
CONFIG_CLK_SIFIVE=y
CONFIG_CLK_SIFIVE_FU540_PRCI=y
# CONFIG_IOMMU_SUPPORT is not set
CONFIG_SIFIVE_PLIC=y
CONFIG_RAS=y
# CONFIG_MANDATORY_FILE_LOCKING is not set
CONFIG_AUTOFS4_FS=y
CONFIG_PROC_CHILDREN=y
CONFIG_TMPFS=y
CONFIG_MISC_FILESYSTEMS=y
CONFIG_NLS=y
CONFIG_CRYPTO_AUTHENC=y
CONFIG_CRYPTO_ECHAINIV=y
CONFIG_CRYPTO_CBC=y
CONFIG_CRYPTO_DES=y
CONFIG_PACKING=y
CONFIG_CRC16=y
CONFIG_CRC_ITU_T=y
CONFIG_CRC7=y
CONFIG_XZ_DEC=y
CONFIG_DMA_CMA=y
CONFIG_CMA_SIZE_MBYTES=32
CONFIG_DMA_API_DEBUG=y
CONFIG_PRINTK_TIME=y
CONFIG_CONSOLE_LOGLEVEL_DEFAULT=8
CONFIG_DYNAMIC_DEBUG=y
CONFIG_DEBUG_INFO=y
CONFIG_DEBUG_INFO_DWARF4=y
CONFIG_GDB_SCRIPTS=y
CONFIG_FRAME_WARN=2048
CONFIG_READABLE_ASM=y
CONFIG_DEBUG_FS=y
# CONFIG_DEBUG_MISC is not set
CONFIG_STACKTRACE=y
# CONFIG_DEBUG_BUGVERBOSE is not set
# CONFIG_FTRACE is not set
# CONFIG_RUNTIME_TESTING_MENU is not set
CONFIG_SMSC_PHY=y
CONFIG_MTD_SPI_NAND=y
CONFIG_MTD=y
CONFIG_MTD_UBI=y
CONFIG_SPI_DEBUG=y
CONFIG_SPI_MASTER=y
CONFIG_EXT4_FS=y
CONFIG_MTD_BLOCK=y
CONFIG_VLAN_8021Q=y
CONFIG_UBIFS_FS=y
CONFIG_DMADEVICES=y
CONFIG_DW_AXI_DMAC=y
```
